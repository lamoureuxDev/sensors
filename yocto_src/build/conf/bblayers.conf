## yocto_src/build/conf/bblayers.conf
```bitbake
# POKY_BBLAYERS_CONF_VERSION is increased each time build/conf/bblayers.conf
# changes incompatibly
POKY_BBLAYERS_CONF_VERSION = "2"

BBPATH = "${TOPDIR}"
BBFILES ?= ""

BBLAYERS ?= " \
  /home/lamoureux/yoctoiot/layers/poky/meta \
  /home/lamoureux/yoctoiot/layers/poky/meta-poky \
  /home/lamoureux/yoctoiot/layers/poky/meta-yocto-bsp \
  /home/lamoureux/yoctoiot/layers/poky/meta-openembedded/meta-oe \
  /home/lamoureux/yoctoiot/layers/poky/meta-freescale \
  /home/lamoureux/yoctoiot/layers/poky/meta-swupdate \
  /home/lamoureux/yoctoiot/layers/poky/meta-fsl-demos \
  /home/lamoureux/yoctoiot/layers/poky/meta-qt5 \
  /home/lamoureux/yoctoiot/layers/poky/openembedded-core/meta-skeleton \
  /home/lamoureux/yoctoiot/layers/poky/meta-sensors \
  "
```

## yocto_src/meta-sensors/conf/layer.conf
```bitbake
# We have a conf and classes directory, add to BBPATH
BBPATH .= ":${LAYERDIR}"

# We have recipes-* directories, add to BBFILES
BBFILES += "${LAYERDIR}/recipes-*/*/*.bb \
            ${LAYERDIR}/recipes-*/*/*.bbappend"

BBFILE_COLLECTIONS += "meta-sensors"
BBFILE_PATTERN_meta-sensors = "^${LAYERDIR}/"
BBFILE_PRIORITY_meta-sensors = "6"

LAYERDEPENDS_meta-sensors = "core"
LAYERSERIES_COMPAT_meta-sensors = "mickledore"

IMAGE_INSTALL += " sensor-stats"
IMAGE_INSTALL += " sensor-simu"
IMAGE_INSTALL += " sensor-alerts"
```
